{"437", "IBM437"},
{"850", "IBM850"},
{"852", "IBM852"},
{"855", "IBM855"},
{"857", "IBM857"},
{"860", "IBM860"},
{"861", "IBM861"},
{"862", "IBM862"},
{"863", "IBM863"},
{"865", "IBM865"},
{"866", "IBM866"},
{"869", "IBM869"},
{"ansi_x3.4-1968", "US-ASCII"},
{"ansi_x3.4-1986", "US-ASCII"},
{"arabic", "ISO-8859-6"},
{"ascii", "US-ASCII"},
{"asmo-708", "ISO-8859-6"},
{"big5", "Big5"},
{"cp-1250", "windows-1250"},
{"cp-1251", "windows-1251"},
{"cp-1252", "windows-1252"},
{"cp-1253", "windows-1253"},
{"cp-1254", "windows-1254"},
{"cp-1255", "windows-1255"},
{"cp-1256", "windows-1256"},
{"cp-1257", "windows-1257"},
{"cp-1258", "windows-1258"},
{"cp-367", "US-ASCII"},
{"cp-437", "IBM437"},
{"cp-775", "IBM775"},
{"cp-819", "ISO-8859-1"},
{"cp-850", "IBM850"},
{"cp-852", "IBM852"},
{"cp-855", "IBM855"},
{"cp-857", "IBM857"},
{"cp-860", "IBM860"},
{"cp-861", "IBM861"},
{"cp-862", "IBM862"},
{"cp-863", "IBM863"},
{"cp-864", "IBM864"},
{"cp-865", "IBM865"},
{"cp-866", "IBM866"},
{"cp-869", "IBM869"},
{"cp-936", "GBK"},
{"cp-gr", "IBM869"},
{"cp-is", "IBM861"},
{"cp367", "US-ASCII"},
{"cp437", "IBM437"},
{"cp775", "IBM775"},
{"cp819", "ISO-8859-1"},
{"cp850", "IBM850"},
{"cp852", "IBM852"},
{"cp855", "IBM855"},
{"cp857", "IBM857"},
{"cp860", "IBM860"},
{"cp861", "IBM861"},
{"cp862", "IBM862"},
{"cp863", "IBM863"},
{"cp864", "IBM864"},
{"cp865", "IBM865"},
{"cp866", "IBM866"},
{"cp869", "IBM869"},
{"cp932", "Shift_JIS"},
{"cp936", "GBK"},
{"cp950", "Big5"},
{"csascii", "US-ASCII"},
{"csbig5", "Big5"},
{"cseuckr", "EUC-KR"},
{"cseucpkdfmtjapanese", "EUC-JP"},
{"csgb2312", "GB2312"},
{"csibm855", "IBM855"},
{"csibm857", "IBM857"},
{"csibm860", "IBM860"},
{"csibm861", "IBM861"},
{"csibm863", "IBM863"},
{"csibm864", "IBM864"},
{"csibm865", "IBM865"},
{"csibm866", "IBM866"},
{"csibm869", "IBM869"},
{"csiso2022jp", "ISO-2022-JP"},
{"csisolatin1", "ISO-8859-1"},
{"csisolatin2", "ISO-8859-2"},
{"csisolatin3", "ISO-8859-3"},
{"csisolatin4", "ISO-8859-4"},
{"csisolatin5", "ISO-8859-9"},
{"csisolatin6", "ISO-8859-10"},
{"csisolatinarabic", "ISO-8859-6"},
{"csisolatincyrillic", "ISO-8859-5"},
{"csisolatingreek", "ISO-8859-7"},
{"csisolatinhebrew", "ISO-8859-8"},
{"cskoi8r", "KOI8-R"},
{"csmacintosh", "macintosh"},
{"cspc775baltic", "IBM775"},
{"cspc850multilingual", "IBM850"},
{"cspc862latinhebrew", "IBM862"},
{"cspc8codepage437", "IBM437"},
{"cspcp852", "IBM852"},
{"csshiftjis", "Shift_JIS"},
{"csunknown8bit", "UNKNOWN-8BIT"},
{"cyrillic", "ISO-8859-5"},
{"ecma-114", "ISO-8859-6"},
{"ecma-118", "ISO-8859-7"},
{"elot_928", "ISO-8859-7"},
{"euc-jp", "EUC-JP"},
{"euc-kr", "EUC-KR"},
{"extended_unix_code_packed_format_for_japanese", "EUC-JP"},
{"gb2312", "GB2312"},
{"gbk", "GBK"},
{"greek", "ISO-8859-7"},
{"greek8", "ISO-8859-7"},
{"hebrew", "ISO-8859-8"},
{"ibm367", "US-ASCII"},
{"ibm437", "IBM437"},
{"ibm775", "IBM775"},
{"ibm819", "ISO-8859-1"},
{"ibm850", "IBM850"},
{"ibm852", "IBM852"},
{"ibm855", "IBM855"},
{"ibm857", "IBM857"},
{"ibm860", "IBM860"},
{"ibm861", "IBM861"},
{"ibm862", "IBM862"},
{"ibm863", "IBM863"},
{"ibm864", "IBM864"},
{"ibm865", "IBM865"},
{"ibm866", "IBM866"},
{"ibm869", "IBM869"},
{"iso-2022-jp", "ISO-2022-JP"},
{"iso-8859-1", "ISO-8859-1"},
{"iso-8859-10", "ISO-8859-10"},
{"iso-8859-13", "ISO-8859-13"},
{"iso-8859-14", "ISO-8859-14"},
{"iso-8859-15", "ISO-8859-15"},
{"iso-8859-16", "ISO-8859-16"},
{"iso-8859-2", "ISO-8859-2"},
{"iso-8859-3", "ISO-8859-3"},
{"iso-8859-4", "ISO-8859-4"},
{"iso-8859-5", "ISO-8859-5"},
{"iso-8859-6", "ISO-8859-6"},
{"iso-8859-7", "ISO-8859-7"},
{"iso-8859-8", "ISO-8859-8"},
{"iso-8859-9", "ISO-8859-9"},
{"iso-celtic", "ISO-8859-14"},
{"iso-ir-100", "ISO-8859-1"},
{"iso-ir-101", "ISO-8859-2"},
{"iso-ir-109", "ISO-8859-3"},
{"iso-ir-110", "ISO-8859-4"},
{"iso-ir-126", "ISO-8859-7"},
{"iso-ir-127", "ISO-8859-6"},
{"iso-ir-138", "ISO-8859-8"},
{"iso-ir-144", "ISO-8859-5"},
{"iso-ir-148", "ISO-8859-9"},
{"iso-ir-157", "ISO-8859-10"},
{"iso-ir-199", "ISO-8859-14"},
{"iso-ir-226", "ISO-8859-16"},
{"iso-ir-6", "US-ASCII"},
{"iso646-us", "US-ASCII"},
{"iso_646.irv:1991", "US-ASCII"},
{"iso_8859-1", "ISO-8859-1"},
{"iso_8859-10:1992", "ISO-8859-10"},
{"iso_8859-14", "ISO-8859-14"},
{"iso_8859-14:1998", "ISO-8859-14"},
{"iso_8859-15", "ISO-8859-15"},
{"iso_8859-16", "ISO-8859-16"},
{"iso_8859-16:2001", "ISO-8859-16"},
{"iso_8859-1:1987", "ISO-8859-1"},
{"iso_8859-2", "ISO-8859-2"},
{"iso_8859-2:1987", "ISO-8859-2"},
{"iso_8859-3", "ISO-8859-3"},
{"iso_8859-3:1988", "ISO-8859-3"},
{"iso_8859-4", "ISO-8859-4"},
{"iso_8859-4:1988", "ISO-8859-4"},
{"iso_8859-5", "ISO-8859-5"},
{"iso_8859-5:1988", "ISO-8859-5"},
{"iso_8859-6", "ISO-8859-6"},
{"iso_8859-6:1987", "ISO-8859-6"},
{"iso_8859-7", "ISO-8859-7"},
{"iso_8859-7:1987", "ISO-8859-7"},
{"iso_8859-8", "ISO-8859-8"},
{"iso_8859-8:1988", "ISO-8859-8"},
{"iso_8859-9", "ISO-8859-9"},
{"iso_8859-9:1989", "ISO-8859-9"},
{"koi8-r", "KOI8-R"},
{"koi8-u", "KOI8-U"},
{"l1", "ISO-8859-1"},
{"l10", "ISO-8859-16"},
{"l2", "ISO-8859-2"},
{"l3", "ISO-8859-3"},
{"l4", "ISO-8859-4"},
{"l5", "ISO-8859-9"},
{"l6", "ISO-8859-10"},
{"l8", "ISO-8859-14"},
{"latin-9", "ISO-8859-15"},
{"latin1", "ISO-8859-1"},
{"latin10", "ISO-8859-16"},
{"latin2", "ISO-8859-2"},
{"latin3", "ISO-8859-3"},
{"latin4", "ISO-8859-4"},
{"latin5", "ISO-8859-9"},
{"latin6", "ISO-8859-10"},
{"latin8", "ISO-8859-14"},
{"mac", "macintosh"},
{"macintosh", "macintosh"},
{"ms936", "GBK"},
{"ms_kanji", "Shift_JIS"},
{"shift_jis", "Shift_JIS"},
{"tis-620", "TIS-620"},
{"unknown-8bit", "UNKNOWN-8BIT"},
{"us", "US-ASCII"},
{"us-ascii", "US-ASCII"},
{"utf-16", "UTF-16"},
{"utf-16be", "UTF-16BE"},
{"utf-16le", "UTF-16LE"},
{"utf-8", "UTF-8"},
{"windows-1250", "windows-1250"},
{"windows-1251", "windows-1251"},
{"windows-1252", "windows-1252"},
{"windows-1253", "windows-1253"},
{"windows-1254", "windows-1254"},
{"windows-1255", "windows-1255"},
{"windows-1256", "windows-1256"},
{"windows-1257", "windows-1257"},
{"windows-1258", "windows-1258"},
{"windows-936", "GBK"},
