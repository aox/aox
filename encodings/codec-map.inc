// generated by $Id: //oryx/src/main/encodings/charset.pl#3 $ at 2007-03-16
if ( name == "Big5" ) codec = new Cp950Codec;
else if ( name == "EUC-JP" ) codec = new EucJpCodec;
else if ( name == "EUC-KR" ) codec = new EucKrCodec;
else if ( name == "GB2312" ) codec = new Gb2312Codec;
else if ( name == "GBK" ) codec = new GbkCodec;
else if ( name == "IBM437" ) codec = new Cp437Codec;
else if ( name == "IBM775" ) codec = new Cp775Codec;
else if ( name == "IBM850" ) codec = new Cp850Codec;
else if ( name == "IBM852" ) codec = new Cp852Codec;
else if ( name == "IBM855" ) codec = new Cp855Codec;
else if ( name == "IBM857" ) codec = new Cp857Codec;
else if ( name == "IBM860" ) codec = new Cp860Codec;
else if ( name == "IBM861" ) codec = new Cp861Codec;
else if ( name == "IBM862" ) codec = new Cp862Codec;
else if ( name == "IBM863" ) codec = new Cp863Codec;
else if ( name == "IBM864" ) codec = new Cp864Codec;
else if ( name == "IBM865" ) codec = new Cp865Codec;
else if ( name == "IBM866" ) codec = new Cp866Codec;
else if ( name == "IBM869" ) codec = new Cp869Codec;
else if ( name == "ISO-2022-JP" ) codec = new Iso2022JpCodec;
else if ( name == "ISO-8859-1" ) codec = new Iso88591Codec;
else if ( name == "ISO-8859-10" ) codec = new Iso885910Codec;
else if ( name == "ISO-8859-13" ) codec = new Iso885913Codec;
else if ( name == "ISO-8859-14" ) codec = new Iso885914Codec;
else if ( name == "ISO-8859-15" ) codec = new Iso885915Codec;
else if ( name == "ISO-8859-16" ) codec = new Iso885916Codec;
else if ( name == "ISO-8859-2" ) codec = new Iso88592Codec;
else if ( name == "ISO-8859-3" ) codec = new Iso88593Codec;
else if ( name == "ISO-8859-4" ) codec = new Iso88594Codec;
else if ( name == "ISO-8859-5" ) codec = new Iso88595Codec;
else if ( name == "ISO-8859-6" ) codec = new Iso88596Codec;
else if ( name == "ISO-8859-7" ) codec = new Iso88597Codec;
else if ( name == "ISO-8859-8" ) codec = new Iso88598Codec;
else if ( name == "ISO-8859-9" ) codec = new Iso88599Codec;
else if ( name == "KOI8-R" ) codec = new Koi8RCodec;
else if ( name == "KOI8-U" ) codec = new Koi8UCodec;
else if ( name == "KS_C_5601-1987" ) codec = new Cp949Codec;
else if ( name == "macintosh" ) codec = new MacRomanCodec;
else if ( name == "Shift_JIS" ) codec = new Cp932Codec;
else if ( name == "TIS-620" ) codec = new Iso885911Codec;
else if ( name == "UNKNOWN-8BIT" ) codec = new Unknown8BitCodec;
else if ( name == "US-ASCII" ) codec = new AsciiCodec;
else if ( name == "UTF-16" ) codec = new Utf16Codec;
else if ( name == "UTF-16BE" ) codec = new Utf16BeCodec;
else if ( name == "UTF-16LE" ) codec = new Utf16LeCodec;
else if ( name == "UTF-8" ) codec = new Utf8Codec;
else if ( name == "windows-1250" ) codec = new Cp1250Codec;
else if ( name == "windows-1251" ) codec = new Cp1251Codec;
else if ( name == "windows-1252" ) codec = new Cp1252Codec;
else if ( name == "windows-1253" ) codec = new Cp1253Codec;
else if ( name == "windows-1254" ) codec = new Cp1254Codec;
else if ( name == "windows-1255" ) codec = new Cp1255Codec;
else if ( name == "windows-1256" ) codec = new Cp1256Codec;
else if ( name == "windows-1257" ) codec = new Cp1257Codec;
else if ( name == "windows-1258" ) codec = new Cp1258Codec;
else ;
