// Generated by $Id: //oryx/src/main/http/make-entitynames#2 $ at 2007-08-08
case 198: r = "&AElig;"; break;
case 193: r = "&Aacute;"; break;
case 194: r = "&Acirc;"; break;
case 192: r = "&Agrave;"; break;
case 913: r = "&Alpha;"; break;
case 197: r = "&Aring;"; break;
case 195: r = "&Atilde;"; break;
case 196: r = "&Auml;"; break;
case 914: r = "&Beta;"; break;
case 199: r = "&Ccedil;"; break;
case 935: r = "&Chi;"; break;
case 8225: r = "&Dagger;"; break;
case 916: r = "&Delta;"; break;
case 208: r = "&ETH;"; break;
case 201: r = "&Eacute;"; break;
case 202: r = "&Ecirc;"; break;
case 200: r = "&Egrave;"; break;
case 917: r = "&Epsilon;"; break;
case 919: r = "&Eta;"; break;
case 203: r = "&Euml;"; break;
case 915: r = "&Gamma;"; break;
case 205: r = "&Iacute;"; break;
case 206: r = "&Icirc;"; break;
case 204: r = "&Igrave;"; break;
case 921: r = "&Iota;"; break;
case 207: r = "&Iuml;"; break;
case 922: r = "&Kappa;"; break;
case 923: r = "&Lambda;"; break;
case 924: r = "&Mu;"; break;
case 209: r = "&Ntilde;"; break;
case 925: r = "&Nu;"; break;
case 338: r = "&OElig;"; break;
case 211: r = "&Oacute;"; break;
case 212: r = "&Ocirc;"; break;
case 210: r = "&Ograve;"; break;
case 937: r = "&Omega;"; break;
case 927: r = "&Omicron;"; break;
case 216: r = "&Oslash;"; break;
case 213: r = "&Otilde;"; break;
case 214: r = "&Ouml;"; break;
case 934: r = "&Phi;"; break;
case 928: r = "&Pi;"; break;
case 8243: r = "&Prime;"; break;
case 936: r = "&Psi;"; break;
case 929: r = "&Rho;"; break;
case 352: r = "&Scaron;"; break;
case 931: r = "&Sigma;"; break;
case 222: r = "&THORN;"; break;
case 932: r = "&Tau;"; break;
case 920: r = "&Theta;"; break;
case 218: r = "&Uacute;"; break;
case 219: r = "&Ucirc;"; break;
case 217: r = "&Ugrave;"; break;
case 933: r = "&Upsilon;"; break;
case 220: r = "&Uuml;"; break;
case 926: r = "&Xi;"; break;
case 221: r = "&Yacute;"; break;
case 376: r = "&Yuml;"; break;
case 918: r = "&Zeta;"; break;
case 225: r = "&aacute;"; break;
case 226: r = "&acirc;"; break;
case 180: r = "&acute;"; break;
case 230: r = "&aelig;"; break;
case 224: r = "&agrave;"; break;
case 8501: r = "&alefsym;"; break;
case 945: r = "&alpha;"; break;
case 38: r = "&amp;"; break;
case 8743: r = "&and;"; break;
case 8736: r = "&ang;"; break;
case 229: r = "&aring;"; break;
case 8776: r = "&asymp;"; break;
case 227: r = "&atilde;"; break;
case 228: r = "&auml;"; break;
case 8222: r = "&bdquo;"; break;
case 946: r = "&beta;"; break;
case 166: r = "&brvbar;"; break;
case 8226: r = "&bull;"; break;
case 8745: r = "&cap;"; break;
case 231: r = "&ccedil;"; break;
case 184: r = "&cedil;"; break;
case 162: r = "&cent;"; break;
case 967: r = "&chi;"; break;
case 710: r = "&circ;"; break;
case 9827: r = "&clubs;"; break;
case 8773: r = "&cong;"; break;
case 169: r = "&copy;"; break;
case 8629: r = "&crarr;"; break;
case 8746: r = "&cup;"; break;
case 164: r = "&curren;"; break;
case 8659: r = "&dArr;"; break;
case 8224: r = "&dagger;"; break;
case 8595: r = "&darr;"; break;
case 176: r = "&deg;"; break;
case 948: r = "&delta;"; break;
case 9830: r = "&diams;"; break;
case 247: r = "&divide;"; break;
case 233: r = "&eacute;"; break;
case 234: r = "&ecirc;"; break;
case 232: r = "&egrave;"; break;
case 8709: r = "&empty;"; break;
case 8195: r = "&emsp;"; break;
case 8194: r = "&ensp;"; break;
case 949: r = "&epsilon;"; break;
case 8801: r = "&equiv;"; break;
case 951: r = "&eta;"; break;
case 240: r = "&eth;"; break;
case 235: r = "&euml;"; break;
case 8364: r = "&euro;"; break;
case 8707: r = "&exist;"; break;
case 402: r = "&fnof;"; break;
case 8704: r = "&forall;"; break;
case 189: r = "&frac12;"; break;
case 188: r = "&frac14;"; break;
case 190: r = "&frac34;"; break;
case 8260: r = "&frasl;"; break;
case 947: r = "&gamma;"; break;
case 8805: r = "&ge;"; break;
case 62: r = "&gt;"; break;
case 8660: r = "&hArr;"; break;
case 8596: r = "&harr;"; break;
case 9829: r = "&hearts;"; break;
case 8230: r = "&hellip;"; break;
case 237: r = "&iacute;"; break;
case 238: r = "&icirc;"; break;
case 161: r = "&iexcl;"; break;
case 236: r = "&igrave;"; break;
case 8465: r = "&image;"; break;
case 8734: r = "&infin;"; break;
case 8747: r = "&int;"; break;
case 953: r = "&iota;"; break;
case 191: r = "&iquest;"; break;
case 8712: r = "&isin;"; break;
case 239: r = "&iuml;"; break;
case 954: r = "&kappa;"; break;
case 8656: r = "&lArr;"; break;
case 955: r = "&lambda;"; break;
case 9001: r = "&lang;"; break;
case 171: r = "&laquo;"; break;
case 8592: r = "&larr;"; break;
case 8968: r = "&lceil;"; break;
case 8220: r = "&ldquo;"; break;
case 8804: r = "&le;"; break;
case 8970: r = "&lfloor;"; break;
case 8727: r = "&lowast;"; break;
case 9674: r = "&loz;"; break;
case 8206: r = "&lrm;"; break;
case 8249: r = "&lsaquo;"; break;
case 8216: r = "&lsquo;"; break;
case 60: r = "&lt;"; break;
case 175: r = "&macr;"; break;
case 8212: r = "&mdash;"; break;
case 181: r = "&micro;"; break;
case 183: r = "&middot;"; break;
case 8722: r = "&minus;"; break;
case 956: r = "&mu;"; break;
case 8711: r = "&nabla;"; break;
case 160: r = "&nbsp;"; break;
case 8211: r = "&ndash;"; break;
case 8800: r = "&ne;"; break;
case 8715: r = "&ni;"; break;
case 172: r = "&not;"; break;
case 8713: r = "&notin;"; break;
case 8836: r = "&nsub;"; break;
case 241: r = "&ntilde;"; break;
case 957: r = "&nu;"; break;
case 243: r = "&oacute;"; break;
case 244: r = "&ocirc;"; break;
case 339: r = "&oelig;"; break;
case 242: r = "&ograve;"; break;
case 8254: r = "&oline;"; break;
case 969: r = "&omega;"; break;
case 959: r = "&omicron;"; break;
case 8853: r = "&oplus;"; break;
case 8744: r = "&or;"; break;
case 170: r = "&ordf;"; break;
case 186: r = "&ordm;"; break;
case 248: r = "&oslash;"; break;
case 245: r = "&otilde;"; break;
case 8855: r = "&otimes;"; break;
case 246: r = "&ouml;"; break;
case 182: r = "&para;"; break;
case 8706: r = "&part;"; break;
case 8240: r = "&permil;"; break;
case 8869: r = "&perp;"; break;
case 966: r = "&phi;"; break;
case 960: r = "&pi;"; break;
case 982: r = "&piv;"; break;
case 177: r = "&plusmn;"; break;
case 163: r = "&pound;"; break;
case 8242: r = "&prime;"; break;
case 8719: r = "&prod;"; break;
case 8733: r = "&prop;"; break;
case 968: r = "&psi;"; break;
case 34: r = "&quot;"; break;
case 8658: r = "&rArr;"; break;
case 8730: r = "&radic;"; break;
case 9002: r = "&rang;"; break;
case 187: r = "&raquo;"; break;
case 8594: r = "&rarr;"; break;
case 8969: r = "&rceil;"; break;
case 8221: r = "&rdquo;"; break;
case 8476: r = "&real;"; break;
case 174: r = "&reg;"; break;
case 8971: r = "&rfloor;"; break;
case 961: r = "&rho;"; break;
case 8207: r = "&rlm;"; break;
case 8250: r = "&rsaquo;"; break;
case 8217: r = "&rsquo;"; break;
case 8218: r = "&sbquo;"; break;
case 353: r = "&scaron;"; break;
case 8901: r = "&sdot;"; break;
case 167: r = "&sect;"; break;
case 173: r = "&shy;"; break;
case 963: r = "&sigma;"; break;
case 962: r = "&sigmaf;"; break;
case 8764: r = "&sim;"; break;
case 9824: r = "&spades;"; break;
case 8834: r = "&sub;"; break;
case 8838: r = "&sube;"; break;
case 8721: r = "&sum;"; break;
case 8835: r = "&sup;"; break;
case 185: r = "&sup1;"; break;
case 178: r = "&sup2;"; break;
case 179: r = "&sup3;"; break;
case 8839: r = "&supe;"; break;
case 223: r = "&szlig;"; break;
case 964: r = "&tau;"; break;
case 8756: r = "&there4;"; break;
case 952: r = "&theta;"; break;
case 977: r = "&thetasym;"; break;
case 8201: r = "&thinsp;"; break;
case 254: r = "&thorn;"; break;
case 732: r = "&tilde;"; break;
case 215: r = "&times;"; break;
case 8482: r = "&trade;"; break;
case 8657: r = "&uArr;"; break;
case 250: r = "&uacute;"; break;
case 8593: r = "&uarr;"; break;
case 251: r = "&ucirc;"; break;
case 249: r = "&ugrave;"; break;
case 168: r = "&uml;"; break;
case 978: r = "&upsih;"; break;
case 965: r = "&upsilon;"; break;
case 252: r = "&uuml;"; break;
case 8472: r = "&weierp;"; break;
case 958: r = "&xi;"; break;
case 253: r = "&yacute;"; break;
case 165: r = "&yen;"; break;
case 255: r = "&yuml;"; break;
case 950: r = "&zeta;"; break;
case 8205: r = "&zwj;"; break;
case 8204: r = "&zwnj;"; break;
